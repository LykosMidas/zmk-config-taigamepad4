## config/Boards/shields/taigamepad4/Kconfig.defconfig
```kconfig
if SHIELD_TAIGAMEPAD4

config ZMK_KEYBOARD_NAME
    default "TAIGAMEPAD4"

endif
```

## config/boards/shields/zerosprey42/Kconfig.defconfig
```kconfig
# Copyright (c) 2020 The ZMK Contributors
# SPDX-License-Identifier: MIT

if SHIELD_TAIGAMEPAD4

config ZMK_KEYBOARD_NAME
    default "taigamepad4"

endif
```

## config/west.yml
```yaml
manifest:
  remotes:
    - name: zmkfirmware
      url-base: https://github.com/zmkfirmware
    - name: LykosMidas
      url-base: https://github.com/LykosMidas
  projects:
    - name: zmk-config-taigamepad4
      remote: LykosMidas
      revision: https://github.com/LykosMidas/zmk-config-taigamepad4
      import: app/west.yml
  self:
    path: config
```
